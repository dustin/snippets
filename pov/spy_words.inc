// Copyright (c) 2002  Dustin Sallings <dustin@spy.net>
//
// $Id: spy_words.inc,v 1.1 2003/04/20 08:19:05 dustin Exp $

#declare word_spy = 
	union {

		object {
			char_S 
			translate <-5, 0, 0>
		}

		object {
			char_P
			translate <0, 0, 0>
		}

		object {
			char_Y 
			translate <5, 0, 0>
		}
	}

// inte rnetwor king  == 15 characters

#declare word_internetworking  =
	union {

		object {
			char_I
			translate <-35, 0, 0>
		}
		
		object {
			char_N
			translate <-30, 0, 0>
		}
		
		object {
			char_T
			translate <-25, 0, 0>
		}
		
		object {
			char_E
			translate <-20, 0, 0>
		}
		
		object {
			char_R
			translate <-15, 0, 0>
		}
		
		object {
			char_N
			translate <-10, 0, 0>
		}
		
		object {
			char_E
			translate <-5, 0, 0>
		}
		
		object {
			char_T
			translate <0, 0, 0>
		}
		
		object {
			char_W
			translate <5, 0, 0>
		}
		
		object {
			char_O
			translate <10, 0, 0>
		}
		
		object {
			char_R
			translate <15, 0, 0>
		}
		
		object {
			char_K
			translate <20, 0, 0>
		}
		
		object {
			char_I
			translate <25, 0, 0>
		}
		
		object {
			char_N
			translate <30, 0, 0>
		}
		
		object {
			char_G
			translate <35, 0, 0>
		}
	}
